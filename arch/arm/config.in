## arch/arm/config.in
```kconfig
# ARM specific configuration file

config ARCH_arm
    select ARCH_SUPPORTS_BOTH_ENDIAN
    select ARCH_DEFAULT_LE
    help
      The ARM architecture, as defined by:
        http://www.arm.com/

config ARCH_ARM_EABI
    bool
    prompt "Use EABI (EXPERIMENTAL)"
    depends on EXPERIMENTAL
    default n
    help
      Set up the toolchain so that it generates EABI-compliant binaries.

config ARCH_ABI
    default "aapcs" if ARCH_ARM_EABI
```

## arch/ia64/config.in
```kconfig
# ia64 specific config options

config ARCH_ia64
    select ARCH_SUPPORTS_BOTH_ENDIAN
    help
      The ia64 architecture, as defined by:
        http://www.intel.com/design/itanium/arch_spec.htm
```

## arch/mips/config.in
```kconfig
# MIPS specific config options

config ARCH_mips
    select ARCH_SUPPORTS_BOTH_ENDIAN
    select ARCH_DEFAULT_BE
    help
      The MIPS architecture, as defined by:
        http://www.mips.com/
```

## arch/powerpc/config.in
```kconfig
# powerpc specific configuration file

config ARCH_powerpc
    select ARCH_SUPPORT_ABI
    select ARCH_SUPPORT_CPU
    select ARCH_SUPPORT_TUNE
    help
      The PowerPC architecture, as defined by:
        http://www.ibm.com/developerworks/eserver/articles/archguide.html

config ARCH_POWERPC_SPE
    bool
    prompt "Enable SPE support (EXPERIMENTAL)"
    depends on EXPERIMENTAL
    default n
    help
      Add support for the Signal Processing Engine.  This will set up
      the toolchain so that it supports the SPE ABI extensions. This
      mainly targets Freescale e500 processors.

      Setting this option will append "spe" to the end of your target
      tuple name (e.g., powerpc-e500v2-linux-gnuspe) so that the gcc
      configure/build system will know to include SPE ABI support.
      It will also automatically add "-mabi=spe -mspe" to your
      TARGET_CFLAGS, and "--enable-e500_double" to your CC_EXTRA_CONFIG,
      so you do not need to explicitly add them.
```

## arch/x86/config.in
```kconfig
# x86 specific options

config ARCH_x86
    help
      The x86 architecture, as defined by:
        http://www.intel.com/
```

## arch/x86_64/config.in
```kconfig
# x86_64 specific options

config ARCH_x86_64
    select ARCH_SUPPORT_ARCH
    select ARCH_SUPPORT_CPU
    select ARCH_SUPPORT_TUNE
    help
      The x86_64 architecture, as defined by:
        http://www.amd.com/us-en/Processors/DevelopWithAMD/0,,30_2252_875_7044,00.html
```

## config/arch/ia64/config.in
```kconfig
# ia64 specific config options
# EXPERIMENTAL

config ARCH_ia64
    select ARCH_SUPPORTS_BOTH_ENDIAN
    help
      The ia64 architecture, as defined by:
        http://www.intel.com/design/itanium/arch_spec.htm
```

## config/arch/sh/config.in
```kconfig
# Super-H specific configuration file
# EXPERIMENTAL

config ARCH_sh
    select ARCH_SUPPORTS_BOTH_ENDIAN
    select ARCH_DEFAULT_LE
    help
      The Super-H architecture, as defined by:
        http://www.renesas.com/fmwk.jsp?cnt=superh_family_landing.jsp&fp=/products/mpumcu/superh_family/

choice
    bool
    prompt "Variant"

config ARCH_SH_SH3
    bool
    prompt "sh3"

config ARCH_SH_SH4
    bool
    prompt "sh4"

config ARCH_SH_SH4A
    bool
    prompt "sh4a"

endchoice

config ARCH_SH_VARIANT
    string
    default "sh3"   if ARCH_SH_SH3
    default "sh4"   if ARCH_SH_SH4
    default "sh4a"  if ARCH_SH_SH4A
```

## config/config.in
```kconfig
source "config/configure.in"
source "config/backend.in"
source "config/global.in"
source "config/target.in"
source "config/toolchain.in"
source "config/kernel.in"
source "config/binutils.in"
source "config/libc.in"
source "config/cc.in"
source "config/debug.in"
source "config/companion_libs.in"
source "config/companion_tools.in"
source "config/test_suite.in"
```
